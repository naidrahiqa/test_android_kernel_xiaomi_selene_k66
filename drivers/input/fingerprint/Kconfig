## drivers/input/fingerprint/Kconfig
```kconfig
#
# Fingerprint
#
menu "Fingerprint support"
	depends on INPUT

config MTK_FINGERPRINT_SUPPORT
	bool "Mediatek Fingerprint"
	default n
	help
	  Fingerprint mtk driver enable/disable in the kernel.
	  Say Y here if you want to use MediaTek fingerprint driver.

if MTK_FINGERPRINT_SUPPORT

config FPC_FINGERPRINT
	tristate "FPC Fingerprint"
	depends on SPI && MICROTRUST_TEE_SUPPORT
	help
	  FPC fingerprint FPC's 102x/104x device.

config GOODIX_FINGERPRINT
	tristate "Goodix Fingerprint"
	depends on SPI && MICROTRUST_TEE_SUPPORT
	help
	  Goodix Fingerprint chip GF316M/GF3208/
	  GF3118M/GF518M/GF5118M/GF516M/GF816M/
	  GF3206/GF3266/GF3288/GF5206/GF5216/GF5208 TEE driver.

config GOODIX_SENSOR_TYPE
	string "SENSOR_TYPE"
	depends on GOODIX_FINGERPRINT
	default "GF5216"
	help
	  Must input sensor type, or default is
	  GF316M GF3208 GF3118M GF518M GF5118M
	  GF516M GF816M GF3206 GF3266 GF3288
	  GF5206 GF5216 GF5208.

endif
endmenu
```

## drivers/oem/Kconfig
```kconfig
config MATCH_XIAOMI
	tristate "Xiaomi Specific Patches on kernel"

config HQ_SYSFS_SUPPORT
	tristate "Huaqin Sysfs Driver"
	depends on MATCH_XIAOMI
	default n
	help
	  Huaqin Sysfs information driver includes specific information about
	  hardware info and other info for HQ tools
```

## drivers/video/backlight/Kconfig
```kconfig
# SPDX-License-Identifier: GPL-2.0

config BACKLIGHT_LM3697
	tristate "TI LM3697 backlight for Selene"
	depends on I2C
	select REGMAP_I2C
	help
	  Enable the Selene-specific TI LM3697 external backlight controller.

config BACKLIGHT_KTD3136
	tristate "Kinetic KTD3136/KTD3137 backlight for Selene"
	depends on I2C
	select REGMAP_I2C
	help
	  Enable the Selene KTD3136/KTD3137-compatible external backlight
	  controller.

config BACKLIGHT_SGM37604A
	tristate "SgMicro SGM37604A Backlight"
	depends on I2C
	help
		Say Y here if you want to enable support for
		the backlight IC SgMicro SGM37604A. The backlight
		IC will send PWM to LED to control the brightness
		of backlight.
```
